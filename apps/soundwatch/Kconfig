## board/contest_board/Kconfig
```kconfig
#
# Contest 2026 team 419 board
#

if ARCH_BOARD_CONTEST2026_419_BOARD

config ARCH_BOARD_CONTEST2026_419_BOARD_TAG
	string "Board tag"
	default "contest2026_419_board"

endif
```
